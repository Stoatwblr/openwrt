// SPDX-License-Identifier: (GPL-2.0-only OR BSD-2-Clause)
/*
 * Copyright (C) 2026 Alan <alan@Riffraff>
 * Copyright (C) 2026 OpenWrt.org
 *
 * ============================================================================
 * LEAF NODE PROFILE: ZYXEL DX3300-T0 CHASSIS DEPLOYMENT
 * ============================================================================
 * Subseries Inheritance: 3300 Wi-Fi 6 Platform Blueprint (Single USB 2.0 Only)
 * RAM Configuration: 512MB High-Capacity Allocation
 * Fleet Relationship Matrix:
 *  - vs DX3301: DX3300 restricts internal XHCI routing to USB 2.0 bandwidth speeds.
 *  - vs EX3300: DX3300 activates the copper VDSL2 vectoring broadband modem core loop.
 */

/dts-v1/;
#include "en751627_zyxel_3300_subseries.dtsi"

/ {
	model = "Zyxel DX3300-T0";
	compatible = "zyxel,dx3300-t0", "econet,en751627";

};

&dsl_modem {
	status = "okay"; /* Enable multi-protocol internal DSL engine */
};
