// SPDX-License-Identifier: (GPL-2.0-only OR BSD-2-Clause)
/*
 * Copyright (C) 2026 Alan <alan@Riffraff>
 * Copyright (C) 2026 OpenWrt.org
 *
 * ============================================================================
 * SUBSERIES SPECIFICATION: 3300 CHASSIS INTERFACES
 * ============================================================================
 * Parent Fleet: en751627_zyxel_T0_series.dtsi
 * Targets: EX3300-T0, DX3300-T0
 * Constraints: Drops USB 3.0 capability to maintain 3300 value specifications.
 */

#include "en751627_zyxel_T0_series.dtsi"

&usb {
  /* Keep only the rear USB 2.0 host engine active */
  status = "okay";
};

&voip_slic {
  status = "disabled"; /* Soft-disable completely for the 3300 variants */
};


